## CMakeLists.txt
```
# SPDX-License-Identifier: Apache-2.0

cmake_minimum_required(VERSION 3.20.0)
find_package(Zephyr REQUIRED HINTS $ENV{ZEPHYR_BASE})
project(external_lib)

# FILE(GLOB adin6310_srcs ${CMAKE_CURRENT_SOURCE_DIR}/lib_adin6310/srcs/*.c)
target_sources(app PRIVATE src/main.c)
# target_include_directories(app PRIVATE ${CMAKE_CURRENT_SOURCE_DIR}/lib_adin6310/inc)
target_link_libraries(app PUBLIC libm.a)

# The external static library that we are linking with does not know
# how to build for this platform so we export all the flags used in
# this zephyr build to the external build system.
#
# Other external build systems may be self-contained enough that they
# do not need any build information from zephyr. Or they may be
# incompatible with certain zephyr options and need them to be
# filtered out.
zephyr_get_include_directories_for_lang_as_string(       C includes)
zephyr_get_system_include_directories_for_lang_as_string(C system_includes)
zephyr_get_compile_definitions_for_lang_as_string(       C definitions)
zephyr_get_compile_options_for_lang_as_string(           C options)

set(external_project_cflags
  "${includes} ${definitions} ${options} ${system_includes} -DDISABLE_AUTOMATIC_FW_UPDATE"
  )

# include(ExternalProject)

# Add an external project to be able download and build the third
# party library. In this case downloading is not necessary as it has
# been committed to the repository.
set(mylib_src_dir   ${CMAKE_CURRENT_SOURCE_DIR}/${EXTLIB_NAME})
set(mylib_build_dir ${CMAKE_CURRENT_BINARY_DIR}/${EXTLIB_NAME})

set(MYLIB_LIB_DIR     ${mylib_src_dir}/lib)
set(MYLIB_INCLUDE_DIR ${mylib_src_dir}/inc ${CMAKE_CURRENT_SOURCE_DIR}/src)

if(CMAKE_GENERATOR STREQUAL "Unix Makefiles")
# https://www.gnu.org/software/make/manual/html_node/MAKE-Variable.html
set(submake "$(MAKE)")
else() # Obviously no MAKEFLAGS. Let's hope a "make" can be found somewhere.
set(submake "make")
endif()

# ExternalProject_Add(
#   adin6310_project                 # Name for custom target
#   PREFIX     ${mylib_build_dir} # Root dir for entire project
#   SOURCE_DIR ${mylib_src_dir}
#   BINARY_DIR ${mylib_src_dir} # This particular build system is invoked from the root
#   CONFIGURE_COMMAND ""    # Skip configuring the project, e.g. with autoconf
#   BUILD_COMMAND
#   ${submake}
#   PREFIX=${mylib_build_dir}
#   CC=${CMAKE_C_COMPILER}
#   AR=${CMAKE_AR}
#   CFLAGS=${external_project_cflags}
#   INSTALL_COMMAND ""      # This particular build system has no install command
#   BUILD_BYPRODUCTS ${MYLIB_LIB_DIR}/libadin6310.a
#   )
```

## prj.conf
```kconfig
CONFIG_TEST_RANDOM_GENERATOR=y
CONFIG_ENTROPY_GENERATOR=y
CONFIG_NETWORKING=y
CONFIG_ETH_DRIVER=y
CONFIG_NET_L2_ETHERNET=y
CONFIG_NET_CONFIG_SETTINGS=y
CONFIG_ETH_ADIN6310=y
CONFIG_MDIO=y
CONFIG_STDOUT_CONSOLE=y
CONFIG_GPIO=y
CONFIG_SPI=y
CONFIG_THREAD_RUNTIME_STATS=y
CONFIG_NET_ZPERF=y
CONFIG_NET_SHELL=y

CONFIG_SENSOR=y
CONFIG_LTC4296=y

CONFIG_NET_TCP=y
CONFIG_NET_SOCKETS=y
CONFIG_POSIX_API=y
CONFIG_NET_SOCKETS_POSIX_NAMES=y
CONFIG_NET_DEFAULT_IF_FIRST=y

CONFIG_NET_IPV4=y
CONFIG_NET_CONFIG_AUTO_INIT=y
CONFIG_NET_CONFIG_MY_IPV4_ADDR="192.168.1.5"
CONFIG_NET_CONFIG_MY_IPV4_GW="0.0.0.0"
CONFIG_NET_INTERFACE_NAME=y
CONFIG_NET_IF_MAX_IPV4_COUNT=6

CONFIG_KERNEL_MEM_POOL=y
CONFIG_HEAP_MEM_POOL_SIZE=10000

CONFIG_MAIN_THREAD_PRIORITY=2
CONFIG_DEBUG_THREAD_INFO=y

CONFIG_LOG=y
CONFIG_LOG_DEFAULT_LEVEL=3

CONFIG_THREAD_CUSTOM_DATA=y
CONFIG_THREAD_NAME=y

CONFIG_ETH_INIT_PRIORITY=50
CONFIG_MDIO_INIT_PRIORITY=50
CONFIG_PHY_INIT_PRIORITY=50

#CONFIG_ETH_ADIN6310_DISABLE_FW_UPDATE=y
```

## src/main.c
```c
/*
 * Copyright (c) 2017 Linaro Limited
 *
 * SPDX-License-Identifier: Apache-2.0
 */

#include <zephyr/kernel.h>
#include <stdio.h>
#include <zephyr/device.h>
#include <zephyr/net/net_config.h>
#include <zephyr/drivers/gpio.h>
#include <zephyr/drivers/spi.h>

#include <netinet/in.h>
#include <sys/socket.h>
#include <arpa/inet.h>
#include <unistd.h>

#include "SMP_stack_api.h"
#include "SES_port_api.h"
#include "SES_switch.h"
#include "SES_frame_api.h"
#include "SES_PORT_interface.h"
#include "SES_interface_management.h"
#include "zephyr/sys/util.h"

#include <zephyr/logging/log.h>
LOG_MODULE_REGISTER(main, CONFIG_LOG_DEFAULT_LEVEL);

#define DISABLE_AUTOMATIC_FW_UPDATE

void print_ipv4(struct net_if *iface, struct net_if_addr *addr, void *user_data)
{
	printf("Iface ip addr: 0x%X\n", addr->address.in_addr.s_addr);
}

static void print_netifs(struct net_if *iface, void *user_data)
{
	struct net_if_addr *if_addr;
	struct in_addr src = { { { 192, 168, 1, 5 } } };

	if_addr = net_if_ipv4_addr_add(iface, &src, NET_ADDR_MANUAL, 0);
	if (!if_addr){
		printf("Error adding ip\n");
	} else {
		printf("Success adding ip\n");
	}
}

static const char content[] = {
	// "HTTP/1.0 200 OK"
	"HTTP/1.0 200 OK; "	\
	"Content-Type: text/html; charset=utf-8\r\n\r\n" \
	"<html>" \
	"<head>" \
	"<title>DWSampleFiles</title>" \
	"<meta charset=\"utf-8\"/>" \
	"<meta http-equiv=\"Content-type\" content=\"text/html; charset=utf-8\"/>" \
	"<meta name=\"viewport\" content=\"width=device-width, initial-scale=1\"/>" \
	"<style type=\"text/css\">* {font-family: Inter;} body {padding: 2em;}</style>" \
	"</head>" \
	"<body>" \
	"<div>" \
	"<h1>Hello world!</h1>" \
	"<p>This is sample 1.</p>" \
	"<!-- Hi! -->" \
	"<p>" \
	"<a href=\"https://www.dwsamplefiles.com/\">Learn More</a>" \
	"</p>" \
	"</div>" \
	"</body>" \
	"</html>"
};

int main(void)
{	
	int ret;
	int srv_fd;
	int counter = 0;
	struct sockaddr_in bind_addr;

	net_if_foreach(print_netifs, NULL);

	srv_fd = socket(AF_INET, SOCK_STREAM, IPPROTO_TCP);
	if (srv_fd < 0)
		return -1;

	bind_addr.sin_family = AF_INET;
	bind_addr.sin_addr.s_addr = htonl(INADDR_ANY);
	bind_addr.sin_port = htons(8080);

	ret = bind(srv_fd, (struct sockaddr *)&bind_addr, sizeof(bind_addr));
	if (ret)
		return ret;

	ret = listen(srv_fd, 5);
	if (ret)
		return ret;

	printf("Single-threaded dumb HTTP server waits for a connection on "
	       "port 8080...\n");

while (1) {
		struct sockaddr_in client_addr;
		socklen_t client_addr_len = sizeof(client_addr);
		char addr_str[32];
		int req_state = 0;
		const char *data;
		size_t len;

		int client = accept(srv_fd, (struct sockaddr *)&client_addr,
				    &client_addr_len);
		if (client < 0) {
			printf("Error in accept: %d - continuing\n", errno);
			continue;
		}

		inet_ntop(client_addr.sin_family, &client_addr.sin_addr,
			  addr_str, sizeof(addr_str));
		printf("Connection #%d from %s\n", counter++, addr_str);

		/* Discard HTTP request (or otherwise client will get
		 * connection reset error).
		 */
		while (1) {
			ssize_t r;
			char c;

			r = recv(client, &c, 1, 0);
			if (r == 0) {
				goto close_client;
			}

			if (r < 0) {
				if (errno == EAGAIN || errno == EINTR) {
					continue;
				}

				printf("Got error %d when receiving from "
				       "socket\n", errno);
				goto close_client;
			}
			if (req_state == 0 && c == '\r') {
				req_state++;
			} else if (req_state == 1 && c == '\n') {
				req_state++;
			} else if (req_state == 2 && c == '\r') {
				req_state++;
			} else if (req_state == 3 && c == '\n') {
				break;
			} else {
				req_state = 0;
			}
		}

		data = content;
		len = sizeof(content);
		while (len) {
			int sent_len = send(client, data, len, 0);

			if (sent_len == -1) {
				printf("Error sending data to peer, errno: %d\n", errno);
				break;
			}
			data += sent_len;
			len -= sent_len;
		}

close_client:
		ret = close(client);
		if (ret == 0) {
			printf("Connection from %s closed\n", addr_str);
		} else {
			printf("Got error %d while closing the "
			       "socket\n", errno);
		}
	}

	return 0;
}
```
