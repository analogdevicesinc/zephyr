## boards/adi/adin6310switch/Kconfig.defconfig
```kconfig
# ADIN6310_ETHERNET_SWITCH board configuration

# Copyright (c) 2024 Analog Devices, Inc.
# SPDX-License-Identifier: Apache-2.0

if BOARD_ADIN6310SWITCH

config BOARD
	default "ADIN6310SWITCH"

endif # BOARD_ADIN6310SWITCH
```

## boards/adi/adin6310t1l/Kconfig.adin6310t1l
```kconfig
# MAX32690 board configuration

# Copyright (c) 2024 Analog Devices, Inc.
# SPDX-License-Identifier: Apache-2.0

config BOARD_ADIN6310T1L
	select SOC_MAX32690_M4 if BOARD_ADIN6310T1L_MAX32690_M4
```

## boards/adi/adin6310t1l/Kconfig.defconfig
```kconfig
# EVAL_ADIN6310T1L_EBZ board configuration

# Copyright (c) 2024 Analog Devices, Inc.
# SPDX-License-Identifier: Apache-2.0

if BOARD_ADIN6310T1L

config BOARD
	default "ADIN6310T1L"

if NETWORKING

config NET_L2_ETHERNET
	default y

endif # NETWORKING

endif # BOARD_ADIN6310T1L
```

## boards/adi/adin6310t1l/board.yml
```yaml
# Copyright (c) 2024 Analog Devices, Inc.
# SPDX-License-Identifier: Apache-2.0

board:
  name: adin6310t1l
  vendor: adi
  socs:
    - name: max32690
```

## boards/adi/max32651evkit/max32651evkit_defconfig
```kconfig
# Copyright (c) 2026 Analog Devices, Inc.
# SPDX-License-Identifier: Apache-2.0

# Enable MPU
CONFIG_ARM_MPU=y

# Enable GPIO
CONFIG_GPIO=y

# Console
CONFIG_CONSOLE=y
CONFIG_UART_CONSOLE=y

# Enable UART
CONFIG_SERIAL=y
CONFIG_UART_INTERRUPT_DRIVEN=y

# Give the path to the key used to sign the image for secure SoC
CONFIG_MAX32_SECURE_SOC_KEY_PATH="C:/analog/SecureBootTools/devices/MAX32651/keys/maximtestcrk.key"
```

## boards/adi/max32657fpga/Kconfig.max32657fpga
```kconfig
# Copyright (c) 2024 Analog Devices, Inc.
# SPDX-License-Identifier: Apache-2.0

config BOARD_MAX32657FPGA
	select SOC_MAX32657 if BOARD_MAX32657FPGA_MAX32657 ||	\
						   BOARD_MAX32657FPGA_MAX32657_NS
```

## boards/adi/max32657fpga/board.yml
```yaml
# Copyright (c) 2024 Analog Devices, Inc.
# SPDX-License-Identifier: Apache-2.0

board:
  name: max32657fpga
  vendor: adi
  socs:
  - name: max32657
    variants:
    - name: "ns"
```

## boards/adi/max78002evkit/board.yml
```yaml
# Copyright (c) 2024 Analog Devices, Inc.
# SPDX-License-Identifier: Apache-2.0

board:
  name: max78002evkit
  vendor: adi
  socs:
    - name: max78002
```

## boards/arm64/adsp_sc598_a55/Kconfig.board
```kconfig
# Copyright (c) 2023 Analog Deivices
# SPDX-License-Identifier: Apache-2.0

config BOARD_ADSP_SC598_A55
	bool "ADSP SC598 CORTEX A55 CPU0"
	depends on SOC_ADSP_SC598_A55
	select ARM64
```

## boards/arm64/adsp_sc598_a55/Kconfig.defconfig
```kconfig
# Copyright (c) 2023 Analog Devices
# SPDX-License-Identifier: Apache-2.0

if BOARD_ADSP_SC598_A55

config BUILD_OUTPUT_BIN
	default y

config BOARD
	default "ADSP_SC598_a55"

endif # BOARD_ADSP_SC598_A55
```

## boards/arm64/adsp_sc598_a55/adsp_sc598_a55_defconfig
```kconfig
CONFIG_SOC_ADSP_SC598_A55=y
CONFIG_BOARD_ADSP_SC598_A55=y
CONFIG_ARM_ARCH_TIMER=y

# Cache management
# CONFIG_CACHE_MANAGEMENT=y

# Enable UART driver
# CONFIG_SERIAL=y

CONFIG_AARCH64_IMAGE_HEADER=y
CONFIG_INIT_STACKS=y

CONFIG_MMU=y
# CONFIG_ARM_MPU=y
# CONFIG_CPU_CORTEX_A55=y
# CONFIG_CPU_HAS_MMU=y
# CONFIG_CPU_HAS_MPU=y
# CONFIG_KERNEL_MEM_POOL=y
CONFIG_GEN_ISR_TABLES=y
CONFIG_PM_DEVICE=y
# CONFIG_BUILTIN_STACK_GUARD=y
# CONFIG_EXTRA_EXCEPTION_INFO=y
# CONFIG_INIT_ARCH_HW_AT_BOOT=y
# CONFIG_ARCH_SUPPORTS_ARCH_HW_INIT=y

# Enable console
CONFIG_CONSOLE=y
# CONFIG_UART_CONSOLE=y

# Enable serial port
# CONFIG_UART_INTERRUPT_DRIVEN=y
```

## drivers/adc/Kconfig.ad4130
```kconfig
# ADC_AD4130 ADC configuration options

# Copyright (c) 2023 Mustafa Abdullah Kus, Sparse Technology
# SPDX-License-Identifier: Apache-2.0

config ADC_AD4130
	bool "AD4130 driver"
	default y
	depends on DT_HAS_ADI_AD4130_ENABLED
	select SPI
	select ADC_CONFIGURABLE_INPUTS
	help
	  Enable the driver implementation for the AD4130

if ADC_AD4130

config ADC_AD4130_INIT_PRIORITY
	int "Init priority"
	default 80
	help
	  ADC_AD4130 ADC device driver initialization priority.

config ADC_AD4130_ASYNC_THREAD_INIT_PRIORITY
	int "ADC ADC_AD4130 async thread priority"
	default 0

config ADC_AD4130_ACQUISITION_THREAD_PRIORITY
	int "Priority for the ADC data acquisition thread"
	default 0
	help
	  Priority level for the internal ADC data acquisition thread.

config ADC_AD4130_ACQUISITION_THREAD_STACK_SIZE
	int "Stack size for the ADC data acquisition thread"
	default 400
	help
	  Size of the stack used for the internal data acquisition
	  thread.

endif # ADC_AD4130
```

## drivers/audio/Kconfig.adau1x61
```kconfig
# Copyright (C) 2024 Analog Devices, Inc.
# SPDX-License-Identifier: Apache-2.0

config AUDIO_ADAU1x61
	bool "ADAU1x61 DAC support"
	depends on I2C
	help
	  Enable Analog Devices ADAU1361/1761/1961 support
```

## drivers/ethernet/Kconfig.adin6310
```kconfig
# Copyright (c) 2023 PHOENIX CONTACT Electronics GmbH
# SPDX-License-Identifier: Apache-2.0

menuconfig ETH_ADIN6310
	bool "ADIN6310 6 port Ethernet Switch"
	default y
	depends on DT_HAS_ADI_ADIN6310_ENABLED
	select SPI
	select THREAD_CUSTOM_DATA
	imply CRC
	help
	  The ADIN6310 is a 6 port Ethernet switch.

if ETH_ADIN6310

config ETH_ADIN6310_IRQ_THREAD_STACK_SIZE
	int "Stack size for a thread that processes ADIN IRQ"
	default 1024
	help
	  Size of the stack used for internal thread which is ran to
	  process raised INT IRQ.s

config ETH_ADIN6310_IRQ_THREAD_PRIO
	int "Priority for internal incoming packet handler"
	default 2
	help
	  Priority level for internal thread which is ran for ADIN
	  INT IRQ processing.

config ETH_ADIN6310_BUFFER_SIZE
	int "Priority for internal incoming packet handler"
	default 2000
	help
	  Size of the buffer used for SPI transactions between the host and
	  ADIN6310.

config ETH_ADIN6310_SEMAPHORE_COUNT
	int "Priority for internal incoming packet handler"
	default 20
	help
	  The number of semaphores required by the ADIN6310 driver.

endif
```

## drivers/mdio/Kconfig.adin6310
```kconfig
# Copyright 2023 PHOENIX CONTACT Electronics GmbH
# SPDX-License-Identifier: Apache-2.0

config MDIO_ADIN6310
	bool "ADIN6310 MDIO driver"
	default y
	help
	  Enable ADIN6310 MDIO driver.
```

## drivers/mdio/Kconfig.adinx11x
```kconfig
# Copyright 2023 PHOENIX CONTACT Electronics GmbH
# SPDX-License-Identifier: Apache-2.0

config MDIO_ADINX11X
	bool "ADINX11X MDIO driver"
	default y
	depends on DT_HAS_ADI_ADINX11X_MDIO_ENABLED
	depends on ETH_ADINX11X
	help
	  Enable ADINX11X MDIO driver.
```

## drivers/sensor/adxl367/Kconfig
```kconfig
# Micropower, 3-Axis, +/-200g Digital Accelerometer

# Copyright (c) 2023 Analog Devices Inc.
# SPDX-License-Identifier: Apache-2.0

menuconfig ADXL367
	bool "ADXL367 Three Axis High-g I2C/SPI accelerometer"
	default y
	depends on DT_HAS_ADI_ADXL367_ENABLED
	select I2C if $(dt_compat_on_bus,$(DT_COMPAT_ADI_ADXL367),i2c)
	select SPI if $(dt_compat_on_bus,$(DT_COMPAT_ADI_ADXL367),spi)
	help
	  Enable driver for ADXL367 Three-Axis Digital Accelerometers.

if ADXL367

choice ADXL367_OP_MODE
	prompt "Operating mode"
	default ADXL367_MEASUREMENT_MODE

config ADXL367_MEASUREMENT_MODE
	bool "Measurement Mode"
	help
	  In this mode, acceleration data is provided continuously at the
	  output data rate (ODR).

endchoice

config ADXL367_ACTIVITY_THRESHOLD
	int "Activity threshold in mg"
	range 0 200000
	default 500
	help
	  Threshold for activity detection.

config ADXL367_INACTIVITY_THRESHOLD
	int "In-activity threshold in mg"
	range 0 200000
	default 400
	help
	  Threshold for in-activity detection.

config ADXL367_ACTIVITY_TIME
	int "Activity time"
	range 0 255
	default 1
	help
	  The activity timer implements a robust activity detection that
	  minimizes false positive motion triggers. When the timer is used,
	  only sustained motion can trigger activity detection.
	  Number of multiples of 3.3 ms activity timer for which above threshold
	  acceleration is required to detect activity. It is 3.3 ms per code
	  for 6400 Hz ODR, and it is 6.6 ms per code for 3200 Hz ODR and below.

config ADXL367_INACTIVITY_TIME
	int "In-activity time"
	range 0 255
	default 2
	help
	  The time that all enabled axes must be lower than the inactivity
	  threshold for an inactivity event to be detected. Number of multiples
	  of 26 ms inactivity timer for which below threshold acceleration is
	  required to detect inactivity. It is 26 ms per code for 3200 Hz ODR
	  and below, and it is 13 ms per code for 6400 Hz ODR.

config ADXL367_REFERENCED_ACTIVITY_DETECTION_MODE
	bool "Use referenced activity/in-activity detection"
	default y
	help
	  Activity detection can be configured as referenced or absolute.
	  When using absolute activity detection, acceleration samples are
	  compared directly to a user set threshold to determine whether
	  motion is present. In many applications, it is advantageous for
	  activity detection to be based not on an absolute threshold,
	  but on a deviation from a reference point or orientation.

endif # ADXL367
```

## drivers/sensor/ltc4296/Kconfig
```kconfig
# LTC4296 PSE Controller configuration options

# Copyright (c) 2024 Antoniu Miclaus
# SPDX-License-Identifier: Apache-2.0

menuconfig LTC4296
	bool "LTC4296 PSE Controller"
	default y
	depends on DT_HAS_ADI_LTC4296_ENABLED
	select SPI
	help
	  Enable the driver for Analog Devices LTC4296 PSE Controller.
```

## dts/bindings/ethernet/adi,adin1300.yaml
```yaml
# Copyright (c) 2024 Analog Devices, Inc.
# SPDX-License-Identifier: Apache-2.0

description: ADIN1300 PHY

compatible: "adi,adin1300"

include: phy.yaml

on-bus: mdio

properties:
  reg:
    required: true
    description: 5-bit physical/port address (PRTAD).
  led0-en:
    type: boolean
    description: Enable LED 0.
  led1-en:
    type: boolean
    description: Enable LED 1.
  disable-tx-mode-24v:
    type: boolean
    description: |
      Disables requirement of 2.4V TX operating mode in the AN advertisement.
```

## dts/bindings/ethernet/adi,adin2111.yaml
```yaml
# Copyright (c) 2023 PHOENIX CONTACT Electronics GmbH
# SPDX-License-Identifier: Apache-2.0

description: |
  ADIN1110 standalone 10BASE-T1L Ethernet controller with SPI interface.

  An example:

  adin2111: adin2111@0 {
          compatible = "adi,adin2111";
          reg = <0x0>;
          spi-max-frequency = <25000000>;
          int-gpios   = <&gpioe 12 (GPIO_ACTIVE_LOW | GPIO_PULL_UP)>;
          reset-gpios = <&gpioe 8 GPIO_ACTIVE_LOW>;
          port1 {
              local-mac-address = [ CA 2F B7 10 23 63 ];
          };
          port2 {
              local-mac-address = [ 3C 82 D4 A2 29 8E ];
          };
          mdio: mdio {
                  compatible = "adi,adinx11x-mdio";
                  status = "okay";
                  #address-cells = <1>;
                  #size-cells = <0>;
                  phy@1 {
                    reg = <0x1>;
                    compatible = "adi,adinx11x-phy";
                    status = "okay";
                  };
                  phy@2 {
                    reg = <0x2>;
                    compatible = "adi,adinx11x-phy";
                    status = "okay";
                  };
          };
  };

compatible: "adi,adin2111"

include: adi,adinx11x.yaml
```

## dts/bindings/ethernet/adi,adin6310.yaml
```yaml
# Copyright (c) 2024 Analog Devices Inc.
# SPDX-License-Identifier: Apache-2.0

description: |
  ADIN6310 Ethernet switch with SPI/Ethernet interface.

compatible: "adi,adin6310"

include: [spi-device.yaml]

bus: adin6310

properties:
  int-gpios:
    type: phandle-array
    required: true
    description: |
      The interrupt pin of ADIN6310 is active low.
      If connected directly the MCU pin should be configured
      as active low.
  reset-gpios:
    type: phandle-array
    description: The reset pin of ADIN6310.

child-binding:
  description: Port properties
  properties:
    local-mac-address:
      type: uint8-array
      description: |
        Specifies the MAC address that was assigned to the network device.
    cpu-port:
      type: boolean
      description: switch configuration port
    phy-connection-type:
      type: string
      description: |
        Specifies the interface connection type between ethernet MAC and PHY.
      enum:
        - "rmii"
        - "rgmii"
        - "sgmii"
```

## dts/bindings/ethernet/adi,adinx11x.yaml
```yaml
# Copyright (c) 2023 PHOENIX CONTACT Electronics GmbH
# SPDX-License-Identifier: Apache-2.0

description: |
  ADINX11X standalone 10BASE-T1L Ethernet controller with SPI interface.

include: [spi-device.yaml]

bus: adinx11x

properties:
  int-gpios:
    type: phandle-array
    required: true
    description: |
      The interrupt pin of ADINX11X is active low.
      If connected directly the MCU pin should be configured
      as active low.
  reset-gpios:
    type: phandle-array
    description: The reset pin of ADINX11X.

child-binding:
  description: Port properties
  properties:
    local-mac-address:
      type: uint8-array
      description: |
        Specifies the MAC address that was assigned to the network device.
```

## dts/bindings/mdio/adi,adin6310-mdio.yaml
```yaml
# Copyright (c) 2023 PHOENIX CONTACT Electronics GmbH
# SPDX-License-Identifier: Apache-2.0

description: ADIN6310 MDIO Driver node

compatible: "adi,adin6310-mdio"

include: mdio-controller.yaml
```

## dts/bindings/mdio/adi,adinx11x-mdio.yaml
```yaml
# Copyright (c) 2023 PHOENIX CONTACT Electronics GmbH
# SPDX-License-Identifier: Apache-2.0

description: ADINX11X MDIO Driver node

compatible: "adi,adinx11x-mdio"

include: mdio-controller.yaml

on-bus: adinx11x

properties:
  "#address-cells":
    required: true
    const: 1

  "#size-cells":
    required: true
    const: 0
```

## dts/bindings/sensor/adi,ltc4296.yaml
```yaml
description: LTC4296 PSE Controller

compatible: "adi,ltc4296"

include: [sensor-device.yaml, spi-device.yaml]

child-binding:
  description: LTC4296 PSE Controller port properties
  properties:
    sccpo-gpios:
      type: phandle-array
      description: |
        The WAKEn pin is asserted to communicate with the sensor.  The
        sensor receives this as an active-low signal.
    sccpi-gpios:
      type: phandle-array
      description: |
        The WAKEn pin is asserted to communicate with the sensor.  The
        sensor receives this as an active-low signal.
    adi,power-class:
      type: int
      description: |
        Specifies the SPE's maximum power class.
    adi,hs-resistor:
      type: int
      description: |
        Specifies the SPE's high-side current sense resistor value.
```
