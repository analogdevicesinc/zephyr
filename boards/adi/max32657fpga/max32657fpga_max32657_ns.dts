/*
 * Copyright (c) 2024 Analog Devices, Inc.
 *
 * SPDX-License-Identifier: Apache-2.0
 */

/dts-v1/;

#include <adi/max32/max32657_ns.dtsi>
#include "max32657fpga_max32657_common.dtsi"

/ {
	 chosen {
		zephyr,sram = &non_secure_ram;
		zephyr,flash = &flash0;
		zephyr,code-partition = &slot0_ns_partition;
	 };
};
