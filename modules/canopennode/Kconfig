## modules/canopennode/Kconfig
```kconfig
# CANopenNode CANopen protocol stack configuration options

# Copyright (c) 2019 Vestas Wind Systems A/S
# Copyright (c) 2024 National Taiwan University Racing Team
# SPDX-License-Identifier: Apache-2.0

config ZEPHYR_CANOPENNODE_MODULE
	bool

config CANOPENNODE
	bool "CANopenNode support"
	select CRC
	depends on CAN && !CAN_FD_MODE
	help
	  This option enables the CANopenNode library.

if CANOPENNODE

config CANOPENNODE_CONFIG_FILE
	string "CANopen config file path"
	help
	  The path to the CANopen config file, use default config if
	  not provided. Refer to the documentation of301/CO_config.h
	  for supported configurations and their defaults.

config CANOPENNODE_SDO_SRV_TIMEOUT_TIME
	int "CANopen"
	default 1000

config CANOPENNODE_SDO_CLI_TIMEOUT_TIME
	int "CANopen"
	default 500

config CANOPENNODE_SDO_CLI_BLOCK
	bool "CANopen"
	default n

config CANOPENNODE_MAINLINE_THREAD_STACK_SIZE
	int "Stack size for the CANopen mainline thread"
	default 2048
	help
	  Size of the stack used for the internal thread which
	  processes time consuming CANopen tasks.

config CANOPENNODE_MAINLINE_THREAD_PRIORITY
	int "Priority for CANopen mainline thread"
	default 5
	help
	  Priority level of the internal thread which processes
	  time consuming CANopen tasks.

config CANOPENNODE_SYNC_THREAD_STACK_SIZE
	int "Stack size for the CANopen SYNC thread"
	default 1024
	help
	  Size of the stack used for the internal thread which
	  processes CANopen SYNC RPDOs and TPDOs.

config CANOPENNODE_SYNC_THREAD_PRIORITY
	int "Priority for CANopen SYNC thread"
	default 0 if !COOP_ENABLED
	default -5
	help
	  Priority level of the internal thread which processes
	  CANopen SYNC RPDOs and TPDOs.

config CANOPENNODE_LEDS_BICOLOR
	bool "CANopen bicolor LED indicator"
	help
	  Handle CANopen LEDs as one bicolor LED, favoring the red LED
	  over the green LED in accordance with the CiA 303-3
	  specification.

config CANOPENNODE_STORAGE_SUBTREE
	string "Settings subtree name for CANopen storage"
	default "canopen"
	help
	  Settings subtree name for CANopen storage

config CANOPENNODE_PROGRAM_DOWNLOAD
	bool "CANopen program download"
	depends on BOOTLOADER_MCUBOOT
	select IMG_MANAGER
	default y
	help
	  Enable support for program download over CANopen according
	  to the CiA 302-3 (draft) specification.

endif # CANOPENNODE
```

## samples/boards/adi_boards/simple_hello_board/sample.yaml
```yaml
sample:
  description: Simple Hello World sample, the simplest Zephyr
    application
  name: simple hello board
common:
  tags: introduction
  integration_platforms:
    - adsp_sc839w
  harness: console
  harness_config:
    type: one_line
    regex:
      - "Simple Hello Board! (.*)"
tests:
    samples.boards.adi_boards.simple_hello_board:
    build_only: true
    platform_allow: adsp_sc839w
    integration_platforms:
      - adsp_sc839w
```

## soc/adi/max32/sbt/Kconfig
```kconfig
# Copyright (c) 2026 Analog Devices, Inc.
# SPDX-License-Identifier: Apache-2.0

config MAX32_SECURE_SOC
	bool "Secure version of the SoC"
	default y
	depends on SOC_MAX32651
	select HAVE_CUSTOM_LINKER_SCRIPT
	help
	  Select this option if the SoC is a secure version. It is required to
	  set the linker configurations and enable image signing.

if MAX32_SECURE_SOC

config CUSTOM_LINKER_SCRIPT
	default "$(ZEPHYR_BASE)/soc/adi/max32/sbt/linker_with_sig_section.ld"

config MAX32_SECURE_SOC_KEY_PATH
	string "Secure SoC's key path"
	help
	  Path to the private key used to sign the image. This is used by the
	  signing tool to sign the image.

endif
```

## soc/arm64/adsp_sc598_a55/Kconfig.defconfig
```kconfig
# Copyright (c) 2023 Analog Devices
# Copyright (c) 2019 Carlo Caione <ccaione@baylibre.com>
# SPDX-License-Identifier: Apache-2.0

if SOC_ADSP_SC598_A55

config SOC
	default "adsp_sc598_a55"

DT_CHOSEN_Z_FLASH := zephyr,flash

config FLASH_SIZE
	default $(dt_chosen_reg_size_int,$(DT_CHOSEN_Z_FLASH),0,K)

config FLASH_BASE_ADDRESS
	default $(dt_chosen_reg_addr_hex,$(DT_CHOSEN_Z_FLASH))

config NUM_IRQS
	int
	default 240

config SYS_CLOCK_HW_CYCLES_PER_SEC
	int
	default 24000000

endif # SOC_ADSP_SC598_A55
```

## soc/arm64/adsp_sc598_a55/Kconfig.soc
```kconfig
# Copyright (c) 2023 Analog Devices
# SPDX-License-Identifier: Apache-2.0

config SOC_ADSP_SC598_A55
	bool "ADSP SC598 cortex A55"
	select ARM64
	select CPU_CORTEX_A55
	select GIC_V3
	select ARMV8_A_NS
	select SEMIHOST
	select SEMIHOST_CONSOLE
	select CPU_HAS_MMU
	select CPU_HAS_MPU
	select ARM_MMU 
```
